## config/west.yml
```yaml
manifest:
  remotes:
    - name: zmkfirmware
      url-base: https://github.com/zmkfirmware
    - name: tangbonze
      url-base: https://github.com/tangbonze
    - name: ItsToxsec
      url-base: https://github.com/ItsToxsec
  projects:
    - name: zmk
      remote: zmkfirmware
      revision: v0.3
      import: app/west.yml
    - name: zmk-pmw3610-driver
      remote: tangbonze
      revision: main
    - name: nice-view-sly
      remote: ItsToxsec
      revision: main
  self:
    path: config
```
